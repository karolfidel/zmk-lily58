## config/west.yml
```yaml
manifest:
  remotes:
    - name: zmkfirmware
      url-base: https://github.com/zmkfirmware
	- name: karolfidel
	  url-base: hattp://github.com/karolfidel/zmkfirmware
    - name: karolfidel
      remote: zmkfirmware
      revision: main
      import: app/west.yml
  self:
    path: config
```
